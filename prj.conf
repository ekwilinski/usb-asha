## CMakeLists.txt
```
cmake_minimum_required(VERSION 3.20.0)
find_package(Zephyr REQUIRED HINTS $ENV{ZEPHYR_BASE})
project(usb_asha)
target_sources(app PRIVATE src/main.c src/indicator.c src/audio.c src/asha.c src/packet_timing.c codec/g722_encode.c)
target_sources_ifdef(CONFIG_USB_ASHA_SONNET3 app PRIVATE src/sonnet_mix.c)
target_sources_ifdef(CONFIG_USB_ASHA_POWER_BUTTON app PRIVATE src/radio_power.c)
target_include_directories(app PRIVATE codec codec/include)

# Two independent G.722 encoders must finish in a single 20 ms connection interval.
set_source_files_properties(codec/g722_encode.c src/audio.c PROPERTIES
  COMPILE_OPTIONS "-O3;-funroll-loops;-fno-tree-loop-distribute-patterns")

if(CONFIG_USB_ASHA_SONNET3)
  zephyr_code_relocate(FILES codec/g722_encode.c LOCATION DSPCODE_TEXT)
  zephyr_code_relocate(FILES codec/g722_encode.c LOCATION RAM_RODATA)
  zephyr_code_relocate(FILES src/audio.c FILTER ".*taps.*" LOCATION RAM_RODATA)
  zephyr_code_relocate(FILES src/audio.c FILTER ".*sonnet_decimate.*" LOCATION DSPCODE_TEXT)
endif()
```

## Kconfig
```
mainmenu "USB ASHA Audio"
config USB_ASHA_SONNET3
	bool "SONNET 3 microphone button and extended upper volume range"

config USB_ASHA_POWER_BUTTON
	bool "Button-selectable radio power and extended upper volume range"

config USB_ASHA_BUILD_NUMBER
	int
	default 268 if USB_ASHA_SONNET3 && USB_ASHA_POWER_BUTTON
	default 269 if USB_ASHA_POWER_BUTTON
	default 267 if USB_ASHA_SONNET3
	default 263

source "Kconfig.zephyr"
```

## west.yml
```
manifest:
  remotes:
    - name: zephyrproject-rtos
      url-base: https://github.com/zephyrproject-rtos
  projects:
    - name: zephyr
      remote: zephyrproject-rtos
      revision: v4.2.2
      import:
        name-allowlist: [cmsis, cmsis_6, cmsis-dsp, hal_nordic, mbedtls, tinycrypt]
  self:
    path: usb-asha
```

## prj.conf
```kconfig
CONFIG_BOARD_SERIAL_BACKEND_CDC_ACM=n
CONFIG_SERIAL=n
CONFIG_CONSOLE=n
CONFIG_USB_DEVICE_STACK=y
CONFIG_USB_DEVICE_INITIALIZE_AT_BOOT=n
CONFIG_USB_DEVICE_PRODUCT="USB ASHA Audio"
CONFIG_USB_DEVICE_MANUFACTURER="USB ASHA"
CONFIG_USB_DEVICE_SOF=y
CONFIG_USB_DEVICE_AUDIO=y
CONFIG_BT=y
CONFIG_BT_CENTRAL=y
CONFIG_BT_SMP=y
CONFIG_BT_PRIVACY=y
CONFIG_BT_GATT_CLIENT=y
CONFIG_BT_GATT_AUTO_DISCOVER_CCC=y
CONFIG_BT_L2CAP_DYNAMIC_CHANNEL=y
CONFIG_BT_MAX_CONN=2
CONFIG_BT_MAX_PAIRED=2
CONFIG_BT_L2CAP_TX_MTU=247
CONFIG_BT_BUF_ACL_RX_SIZE=251
CONFIG_BT_BUF_ACL_TX_SIZE=251
CONFIG_BT_CTLR_DATA_LENGTH_MAX=251
CONFIG_BT_BUF_ACL_TX_COUNT=10
CONFIG_BT_CONN_TX_MAX=10
CONFIG_BT_ATT_TX_COUNT=6
CONFIG_BT_BUF_CMD_TX_COUNT=4
CONFIG_FLASH=y
CONFIG_FLASH_MAP=y
CONFIG_NVS=y
CONFIG_SETTINGS=y
CONFIG_BT_SETTINGS=y
CONFIG_EVENTS=y
CONFIG_PICOLIBC=y
CONFIG_COMMON_LIBC_MALLOC_ARENA_SIZE=4096
CONFIG_CMSIS_DSP=y
CONFIG_CMSIS_DSP_FILTERING=y
CONFIG_MAIN_STACK_SIZE=6144
CONFIG_SYSTEM_WORKQUEUE_STACK_SIZE=2560
CONFIG_BT_RX_STACK_SIZE=2560
CONFIG_BT_BUF_EVT_RX_COUNT=16
CONFIG_CLOCK_CONTROL_NRF_K32SRC_RC=y
CONFIG_CLOCK_CONTROL_NRF_K32SRC_500PPM=y
CONFIG_USB_NRFX_WORK_QUEUE_STACK_SIZE=2048
# The factory S113 7.2.0 occupies flash below 0x1c000. Bond storage begins at 0xf0000.
CONFIG_FLASH_LOAD_OFFSET=0x1c000
CONFIG_FLASH_LOAD_SIZE=0xd4000

CONFIG_USB_NRFX_EVT_QUEUE_SIZE=64
CONFIG_REBOOT=y

# Reserve the highest interrupt level for the Nordic controller's time-critical radio ISR.
CONFIG_ZERO_LATENCY_IRQS=y
CONFIG_BT_CTLR_ZLI=y

CONFIG_CMSIS_DSP_LOOPUNROLL=y
```

## app.overlay
```dts
&zephyr_udc0 {
	headphones {
		compatible = "usb-audio-hp";
		channel-l;
		channel-r;
		sample-rate-hz = <48000>;
		resolution = <16>;
		feature-mute;
		feature-volume;
		volume-max = <0>;
		volume-min = <0xd000>;
		volume-res = <0x100>;
	};
};

&board_cdc_acm_uart {
	status = "disabled";
};
```

## src/main.c
```c
#include "asha.h"
#include "dongle_controls.h"
#include "indicator.h"
#include <zephyr/drivers/gpio.h>

static const struct gpio_dt_spec button = GPIO_DT_SPEC_GET(DT_ALIAS(sw0), gpios);

int main(void)
{
	indicator_init();
	gpio_pin_configure_dt(&button, GPIO_INPUT);
	int err = audio_init();
	if (!err) { err = asha_init(); }
	if (err) {
		atomic_set(&diag_error, err);
		indicator_set(LED_ERROR);
		return err;
	}
	int64_t last_audio = 0;
#if defined(CONFIG_USB_ASHA_SONNET3) || defined(CONFIG_USB_ASHA_POWER_BUTTON)
	struct button_state button_state = {0};
#else
	int64_t pressed = -1;
#endif
	for (;;) {
		int64_t now = k_uptime_get();
		bool down = gpio_pin_get_dt(&button) > 0;
#if defined(CONFIG_USB_ASHA_SONNET3) || defined(CONFIG_USB_ASHA_POWER_BUTTON)
		enum button_action action = button_update(&button_state, down, now);
#ifdef CONFIG_USB_ASHA_POWER_BUTTON
		if (action == BUTTON_POWER) { asha_cycle_power(); }
#endif
		if (action == BUTTON_RESET) {
#ifdef CONFIG_USB_ASHA_SONNET3
			if (!asha_forget()) { asha_pair(); }
			else { indicator_feedback(0); }
#else
			if (asha_forget()) { indicator_feedback(0); }
#endif
		} else if (action == BUTTON_TAP) {
#ifdef CONFIG_USB_ASHA_SONNET3
			asha_toggle_mics();
#else
			asha_pair();
#endif
		}
#else
		if (down) {
			if (pressed < 0) { pressed = now; }
		} else if (pressed >= 0) {
			if (now - pressed >= 5000) { asha_forget(); }
			else if (now - pressed >= 30) { asha_pair(); }
			pressed = -1;
		}
#endif
		asha_poll();
		struct audio_frame *frame = audio_take(K_MSEC(10));
		if (frame) {
			last_audio = k_uptime_get();
			asha_audio(frame);
			audio_release(frame);
		} else if (asha_playing() && k_uptime_get() - last_audio >= 150) {
			asha_stop();
		}
		enum led_state state = asha_playing() ? LED_AUDIO : asha_ready() ? LED_CONNECTED :
				       asha_pairing() ? LED_SEARCH : LED_IDLE;
		indicator_set(state);
	}
}
```

## src/asha.c
```c
#include "asha.h"
#include "indicator.h"
#ifdef CONFIG_USB_ASHA_POWER_BUTTON
#include "dongle_controls.h"
#include "radio_power.h"
BUILD_ASSERT(CONFIG_BT_CTLR_TX_PWR_DBM == 4 && IS_ENABLED(CONFIG_BT_CTLR_TX_PWR_DYNAMIC_CONTROL));
static atomic_t selected_dbm = CONFIG_BT_CTLR_TX_PWR_DBM;
#endif
#ifdef CONFIG_USB_ASHA_SONNET3
#include "sonnet_mix.h"
#endif
#include "packet_timing.h"
#include <zephyr/bluetooth/bluetooth.h>
#include <zephyr/bluetooth/conn.h>
#include <zephyr/bluetooth/gatt.h>
#include <zephyr/bluetooth/l2cap.h>
#include <zephyr/settings/settings.h>
#include <zephyr/sys/byteorder.h>
#include <string.h>

enum characteristic { PROPERTIES, CONTROL, STATUS, VOLUME, PSM, CHAR_COUNT };
#define UUID(a,b,c,d,e) BT_UUID_INIT_128(BT_UUID_128_ENCODE(a,b,c,d,e))
static const struct bt_uuid_128 uuid[CHAR_COUNT] = {
	[PROPERTIES] = UUID(0x6333651e,0xc481,0x4a3e,0x9169,0x7c902aad37bb),
	[CONTROL] = UUID(0xf0d4de7e,0x4a88,0x476c,0x9d9f,0x1937b0996cc0),
	[STATUS] = UUID(0x38663f1a,0xe711,0x4cac,0xb641,0x326b56404837),
	[VOLUME] = UUID(0x00e4ca9e,0xab14,0x41e4,0x8823,0xf9e70c7e91df),
	[PSM] = UUID(0x2d410339,0x82b6,0x42aa,0xb34e,0xe2e01df8cc1a),
};
static const struct bt_uuid_128 sonnet_service = UUID(0x5f3b2e9a,0x961f,0x1883,0xd24e,0x59d8b0f44f78);
static const struct bt_uuid_16 service = BT_UUID_INIT_16(0xfdf0);
enum event { CONNECTED = BIT(0), ENCRYPTED = BIT(1), DONE = BIT(2), ACK = BIT(3),
	     OPEN = BIT(4), FAILED = BIT(5), DOWN = BIT(6), TIMING = BIT(7) };
enum stage { IDLE, CONNECT, SECURE, DISCOVER, READ_PROPERTIES, READ_PSM, SUBSCRIBE,
	     OPEN_CHANNEL, READY, START, STREAMING, STOP };

struct peer {
	struct k_event events;
	struct bt_conn *conn;
	struct bt_l2cap_le_chan channel;
	struct bt_gatt_discover_params discovery, ccc_discovery;
	struct bt_gatt_read_params read;
	struct bt_gatt_write_params write;
	struct bt_gatt_subscribe_params subscription;
	uint16_t first, last, handle[CHAR_COUNT], status_ccc, psm;
	uint8_t props[17], read_length, command[5];
	bool ready, started, temporary_bond;
	int volume;
};
static struct peer peers[SIDES];
BUILD_ASSERT(ARRAY_SIZE(peers) == CONFIG_BT_MAX_CONN);
NET_BUF_POOL_FIXED_DEFINE(audio_buffers, SIDES * 8, BT_L2CAP_SDU_BUF_SIZE(1 + CODE_BYTES),
			  CONFIG_BT_CONN_TX_USER_DATA_SIZE, NULL);
K_MSGQ_DEFINE(candidates, sizeof(bt_addr_le_t), 1, 1);
static bool scanning, playing;
static atomic_t pairing;
static int64_t pair_until, scan_after;
static uint8_t sequence;
static uint16_t stream;
static bool sent_first_frame;

static struct peer *link(struct bt_conn *conn) { return &peers[bt_conn_index(conn)]; }

static void fail(struct peer *p, int reason)
{
	atomic_set(&diag_error, reason);
	k_event_post(&p->events, FAILED);
}

static int wait_for(struct peer *p, uint32_t needed, int timeout_ms)
{
	int64_t until = k_uptime_get() + timeout_ms;
	while (needed) {
		int64_t remaining = until - k_uptime_get();
		if (remaining <= 0) {
			return -ETIMEDOUT;
		}
		uint32_t got = k_event_wait(&p->events, needed | FAILED | DOWN, false, K_MSEC(remaining));
		if (!got) { return -ETIMEDOUT; }
		if (got & DOWN) { return -ENOTCONN; }
		if (got & FAILED) { return -EIO; }
		needed &= ~got;
	}
	return 0;
}

static void connected(struct bt_conn *conn, uint8_t err)
{
	k_event_post(&link(conn)->events, err ? DOWN : CONNECTED);
}
static void disconnected(struct bt_conn *conn, uint8_t reason)
{
	atomic_inc(&diag_disconnects);
	if (reason != BT_HCI_ERR_LOCALHOST_TERM_CONN) { atomic_set(&diag_error, reason); }
	k_event_post(&link(conn)->events, DOWN);
}
static void secured(struct bt_conn *conn, bt_security_t level, enum bt_security_err err)
{
	struct peer *p = link(conn);
	if (err || level < BT_SECURITY_L2) { fail(p, err ? err : -EACCES); }
	else { k_event_post(&p->events, ENCRYPTED); }
}
static bool params_requested(struct bt_conn *conn, struct bt_le_conn_param *params)
{
	if (params->interval_min > 16 || params->interval_max < 16) { return false; }
	params->interval_min = params->interval_max = 16;
	params->latency = 0;
	return true;
}
static void params_changed(struct bt_conn *conn, uint16_t interval, uint16_t latency, uint16_t timeout)
{
	struct peer *p = link(conn);
	if (interval != 16 || latency) { fail(p, -ERANGE); }
	else { k_event_post(&p->events, TIMING); }
}
BT_CONN_CB_DEFINE(connection_events) = {
	.connected = connected, .disconnected = disconnected, .security_changed = secured,
	.le_param_req = params_requested, .le_param_updated = params_changed,
};

static void channel_open(struct bt_l2cap_chan *chan)
{
	struct peer *p = CONTAINER_OF(chan, struct peer, channel.chan);
	timing_channel_open(p - peers);
	if (p->channel.tx.mtu < CODE_BYTES + 1) { fail(p, -EMSGSIZE); }
	else { k_event_post(&p->events, OPEN); }
}
static void channel_closed(struct bt_l2cap_chan *chan)
{
	fail(CONTAINER_OF(chan, struct peer, channel.chan), -ENOTCONN);
}
static int channel_receive(struct bt_l2cap_chan *chan, struct net_buf *buf) { return 0; }
static void channel_sent(struct bt_l2cap_chan *chan)
{
	struct peer *p = CONTAINER_OF(chan, struct peer, channel.chan);
	timing_complete(p - peers);
}
static const struct bt_l2cap_chan_ops channel_ops = {
	.sent = channel_sent,
	.connected = channel_open, .disconnected = channel_closed, .recv = channel_receive,
};

static uint8_t discover_cb(struct bt_conn *conn, const struct bt_gatt_attr *attr,
			   struct bt_gatt_discover_params *params)
{
	struct peer *p = link(conn);
	if (!attr) {
		k_event_post(&p->events, DONE);
		return BT_GATT_ITER_STOP;
	}
	if (params->type == BT_GATT_DISCOVER_PRIMARY) {
		const struct bt_gatt_service_val *s = attr->user_data;
		p->first = attr->handle + 1;
		p->last = s->end_handle;
		k_event_post(&p->events, DONE);
		return BT_GATT_ITER_STOP;
	}
	const struct bt_gatt_chrc *ch = attr->user_data;
	for (int i = 0; i < CHAR_COUNT; ++i) {
		if (!bt_uuid_cmp(ch->uuid, &uuid[i].uuid)) {
			p->handle[i] = ch->value_handle;
			if (i == STATUS) {
				p->status_ccc = ch->properties & BT_GATT_CHRC_NOTIFY ? BT_GATT_CCC_NOTIFY :
					ch->properties & BT_GATT_CHRC_INDICATE ? BT_GATT_CCC_INDICATE : 0;
			}
		}
	}
	return BT_GATT_ITER_CONTINUE;
}

static int discover(struct peer *p, bool primary)
{
	p->discovery = (struct bt_gatt_discover_params){
		.uuid = primary ? &service.uuid : NULL, .func = discover_cb,
		.start_handle = primary ? BT_ATT_FIRST_ATTRIBUTE_HANDLE : p->first,
		.end_handle = primary ? BT_ATT_LAST_ATTRIBUTE_HANDLE : p->last,
		.type = primary ? BT_GATT_DISCOVER_PRIMARY : BT_GATT_DISCOVER_CHARACTERISTIC,
	};
	k_event_clear(&p->events, DONE);
	int err = bt_gatt_discover(p->conn, &p->discovery);
	return err ? err : wait_for(p, DONE, 6000);
}

static uint8_t read_cb(struct bt_conn *conn, uint8_t err, struct bt_gatt_read_params *params,
		       const void *data, uint16_t len)
{
	struct peer *p = link(conn);
	if (err || !data || len != p->read_length) {
		fail(p, err ? err : -EBADMSG);
	} else {
		if (len == sizeof(p->props)) { memcpy(p->props, data, len); }
		else { p->psm = sys_get_le16(data); }
		k_event_post(&p->events, DONE);
	}
	return BT_GATT_ITER_STOP;
}
static int read_value(struct peer *p, enum characteristic key, uint8_t length)
{
	p->read_length = length;
	p->read = (struct bt_gatt_read_params){.func = read_cb, .handle_count = 1,
					      .single.handle = p->handle[key]};
	k_event_clear(&p->events, DONE);
	int err = bt_gatt_read(p->conn, &p->read);
	return err ? err : wait_for(p, DONE, 5000);
}

static void subscribed(struct bt_conn *conn, uint8_t err, struct bt_gatt_subscribe_params *params)
{
	if (err) { fail(link(conn), err); }
	else { k_event_post(&link(conn)->events, DONE); }
}
static uint8_t notified(struct bt_conn *conn, struct bt_gatt_subscribe_params *params,
			const void *data, uint16_t len)
{
	if (!data) { return BT_GATT_ITER_STOP; }
	struct peer *p = link(conn);
	if (len != 1 || *(const uint8_t *)data != 0) {
		fail(p, len == 1 ? (int8_t)*(const uint8_t *)data : -EBADMSG);
	} else {
		k_event_post(&p->events, ACK);
	}
	return BT_GATT_ITER_CONTINUE;
}
static void wrote(struct bt_conn *conn, uint8_t err, struct bt_gatt_write_params *params)
{
	if (err) { fail(link(conn), err); }
	else { k_event_post(&link(conn)->events, DONE); }
}

static int control(struct peer *p, bool start, bool paired)
{
	atomic_set(&diag_stage, start ? START : STOP);
	p->volume = audio_volume();
	p->command[0] = start ? 1 : 2;
	p->command[1] = 1;
	p->command[2] = 3;
	p->command[3] = (uint8_t)p->volume;
	p->command[4] = paired;
	p->write = (struct bt_gatt_write_params){.func = wrote, .handle = p->handle[CONTROL],
		.data = p->command, .length = start ? 5 : 1};
	k_event_clear(&p->events, DONE | ACK);
	int err = bt_gatt_write(p->conn, &p->write);
	return err ? err : wait_for(p, DONE | ACK, 3000);
}

static int setup(struct peer *p)
{
	atomic_set(&diag_stage, SECURE);
	int err = bt_conn_set_security(p->conn, BT_SECURITY_L2);
	if (err) { return err; }
	if (bt_conn_get_security(p->conn) < BT_SECURITY_L2 && (err = wait_for(p, ENCRYPTED, 20000))) {
		return err;
	}
	atomic_set(&diag_stage, DISCOVER);
	if ((err = discover(p, true)) || !p->first) { return err ? err : -ENOENT; }
	if ((err = discover(p, false))) { return err; }
	for (unsigned i = 0; i < CHAR_COUNT; i++) {
		if (!p->handle[i]) { return -ENOENT; }
	}
	if (!p->status_ccc) { return -ENOTSUP; }
	atomic_set(&diag_stage, READ_PROPERTIES);
	if ((err = read_value(p, PROPERTIES, sizeof(p->props)))) { return err; }
	if (p->props[0] != 1 || !(p->props[10] & 1) || !(sys_get_le16(p->props + 15) & 2)) {
		return -ENOTSUP;
	}
	for (unsigned i = 0; i < SIDES; i++) {
		struct peer *other = &peers[i];
		if (other->ready && (!(other->props[1] & p->props[1] & 2) ||
		    !((other->props[1] ^ p->props[1]) & 1) ||
		    memcmp(other->props + 2, p->props + 2, 8))) {
			return -EXDEV;
		}
	}
	atomic_set(&diag_stage, READ_PSM);
	if ((err = read_value(p, PSM, 2))) { return err; }
	if (p->psm < 0x80 || p->psm > 0xff) { return -EBADMSG; }
	atomic_set(&diag_stage, SUBSCRIBE);
	p->subscription = (struct bt_gatt_subscribe_params){.notify = notified, .subscribe = subscribed,
		.value_handle = p->handle[STATUS], .end_handle = p->last, .value = p->status_ccc,
		.disc_params = &p->ccc_discovery, .min_security = BT_SECURITY_L2};
	atomic_set_bit(p->subscription.flags, BT_GATT_SUBSCRIBE_FLAG_VOLATILE);
	k_event_clear(&p->events, DONE);
	err = bt_gatt_subscribe(p->conn, &p->subscription);
	if (err || (err = wait_for(p, DONE, 5000))) { return err; }
	atomic_set(&diag_stage, OPEN_CHANNEL);
	p->channel.chan.ops = &channel_ops;
	p->channel.required_sec_level = BT_SECURITY_L2;
	err = bt_l2cap_chan_connect(p->conn, &p->channel.chan, p->psm);
	if (err || (err = wait_for(p, OPEN, 5000))) { return err; }
	struct bt_conn_info info;
	if ((err = bt_conn_get_info(p->conn, &info))) { return err; }
	if (info.le.interval != 16 || info.le.latency != 0) { return -ERANGE; }
	p->temporary_bond = false;
	p->ready = true;
	atomic_set(&diag_stage, READY);
	return 0;
}

static bool advertised(struct bt_data *ad, void *user)
{
	bool *found = user;
	switch (ad->type) {
	case BT_DATA_SVC_DATA16:
		*found = ad->data_len >= 2 && sys_get_le16(ad->data) == service.val;
		break;
	case BT_DATA_UUID16_ALL:
	case BT_DATA_UUID16_SOME:
		for (unsigned i = 0; i + 2 <= ad->data_len; i += 2) {
			if (sys_get_le16(ad->data + i) == service.val) { *found = true; break; }
		}
		break;
	case BT_DATA_UUID128_ALL:
	case BT_DATA_UUID128_SOME:
	case BT_DATA_SVC_DATA128:
		for (unsigned i = 0; i + 16 <= ad->data_len; i += 16) {
			if (!memcmp(ad->data + i, sonnet_service.val, 16)) { *found = true; break; }
			if (ad->type == BT_DATA_SVC_DATA128) { break; }
		}
		break;
	case BT_DATA_NAME_COMPLETE:
	case BT_DATA_NAME_SHORTENED:
		/* Some SONNET advertising modes announce the product name first. */
		*found = ad->data_len >= 8 && !memcmp(ad->data, "SONNET 3", 8);
		break;
	}
	return !*found;
}

static void found(const bt_addr_le_t *addr, int8_t rssi, uint8_t type, struct net_buf_simple *ad)
{
	if (type != BT_GAP_ADV_TYPE_ADV_IND && type != BT_GAP_ADV_TYPE_ADV_DIRECT_IND &&
	    type != BT_GAP_ADV_TYPE_SCAN_RSP) { return; }
	atomic_inc(&diag_advertisements);
	bool eligible = bt_le_bond_exists(BT_ID_DEFAULT, addr);
	if (!eligible && atomic_get(&pairing)) { bt_data_parse(ad, advertised, &eligible); }
	if (eligible) {
		atomic_inc(&diag_matches);
		k_msgq_put(&candidates, addr, K_NO_WAIT);
	}
}

static void stop_scan(void)
{
	if (scanning) {
		bt_le_scan_stop();
		scanning = false;
	}
	k_msgq_purge(&candidates);
}
static void drop(struct peer *p, int err)
{
	if (!k_event_test(&p->events, FAILED)) { atomic_set(&diag_error, err); }
	k_event_post(&p->events, FAILED);
	p->ready = false;
	p->started = false;
	bt_conn_disconnect(p->conn, BT_HCI_ERR_REMOTE_USER_TERM_CONN);
	scan_after = k_uptime_get() + 2000;
}

unsigned asha_ready(void)
{
	unsigned count = 0;
	for (unsigned i = 0; i < SIDES; ++i) { count += peers[i].ready; }
	return count;
}
bool asha_pairing(void) { return atomic_get(&pairing); }
bool asha_playing(void) { return playing; }

void asha_stop(void)
{
	playing = false;
	for (unsigned i = 0; i < SIDES; ++i) {
		struct peer *p = &peers[i];
		if (p->started) {
			p->started = false;
			int err = control(p, false, false);
			if (err) { drop(p, err); }
		}
	}
	audio_flush();
}

static void tell_other(struct peer *changed, uint8_t state)
{
	const uint8_t status[] = {3, state};
	for (unsigned i = 0; i < SIDES; ++i) {
		struct peer *p = &peers[i];
		if (p == changed || !p->ready) { continue; }
		int err = bt_gatt_write_without_response(p->conn, p->handle[CONTROL], status, sizeof(status), false);
		if (err) { drop(p, err); }
	}
}

static void attach(const bt_addr_le_t *addr)
{
	bool known = bt_le_bond_exists(BT_ID_DEFAULT, addr);
	if (!known && !asha_pairing()) { return; }
	struct bt_conn *existing = bt_conn_lookup_addr_le(BT_ID_DEFAULT, addr);
	if (existing) { bt_conn_unref(existing); return; }
	stop_scan();
	asha_stop();
	indicator_set(LED_CONNECT);
	atomic_set(&diag_stage, CONNECT);
	atomic_set(&diag_error, 0);
	struct bt_conn_le_create_param create =
		BT_CONN_LE_CREATE_PARAM_INIT(BT_CONN_LE_OPT_NONE, 96, 48);
	create.timeout = 500; /* 5 s in 10 ms units */
	struct bt_conn *conn = NULL;
	int err = bt_conn_le_create(addr, &create, BT_LE_CONN_PARAM(16, 16, 0, 400), &conn);
	if (err) {
		atomic_set(&diag_error, err);
		scan_after = k_uptime_get() + 500;
		return;
	}
	struct peer *p = link(conn);
	p->conn = conn;
	p->temporary_bond = !known;
	err = wait_for(p, CONNECTED, 6500);
#ifdef CONFIG_USB_ASHA_POWER_BUTTON
	if (!err) { err = radio_set_link_power(conn, atomic_get(&selected_dbm)); }
#endif
	if (!err) { err = setup(p); }
	if (err) { drop(p, err); }
	else {
		indicator_confirm();
		tell_other(p, 1);
		if (!(p->props[1] & 2) || asha_ready() == SIDES) { atomic_clear(&pairing); }
	}
}

void asha_poll(void)
{
	if (k_uptime_get() >= pair_until) { atomic_clear(&pairing); }
	unsigned occupied = 0;
	for (unsigned i = 0; i < SIDES; ++i) {
		struct peer *p = &peers[i];
		if (!p->conn) { continue; }
		uint32_t events = k_event_test(&p->events, DOWN | FAILED | TIMING);
		if (events & DOWN) {
			bool was_ready = p->ready || p->started;
			p->started = p->ready = false;
			if (was_ready || playing) {
				asha_stop();
				tell_other(p, 0);
			}
			if (p->temporary_bond) { bt_unpair(BT_ID_DEFAULT, bt_conn_get_dst(p->conn)); }
			struct bt_conn *old = p->conn;
			memset(p, 0, sizeof(*p));
			k_event_init(&p->events);
			bt_conn_unref(old);
			scan_after = k_uptime_get() + 1000;
			continue;
		}
		if ((events & FAILED) && p->ready) {
			drop(p, -EIO);
			asha_stop();
			tell_other(p, 0);
		}
		if (events & TIMING) {
			k_event_clear(&p->events, TIMING);
			tell_other(p, 2);
		}
		occupied++;
	}
	unsigned ready = asha_ready();
	atomic_set(&diag_links, ready);
	if (occupied >= SIDES || (ready && !(peers[peers[0].ready ? 0 : 1].props[1] & 2))) {
		stop_scan();
		return;
	}
	if (k_uptime_get() < scan_after) { return; }
	if (!scanning) {
		const struct bt_le_scan_param scan = {.type = BT_LE_SCAN_TYPE_ACTIVE, .interval = 96, .window = 32};
		scanning = bt_le_scan_start(&scan, found) == 0;
		if (!scanning) { scan_after = k_uptime_get() + 500; }
	}
	bt_addr_le_t addr;
	if (k_msgq_get(&candidates, &addr, K_NO_WAIT) == 0) { attach(&addr); }
}

#ifdef CONFIG_USB_ASHA_POWER_BUTTON
int asha_power_dbm(void)
{
	return atomic_get(&selected_dbm);
}

/* Peer setup, removal and button presses run on the same application thread. */
void asha_cycle_power(void)
{
	int prior = asha_power_dbm();
	int next = next_radio_dbm(prior);
	unsigned touched = 0;
	int err = 0;
	for (unsigned i = 0; i < SIDES; ++i) {
		struct peer *p = &peers[i];
		if (!p->conn || k_event_test(&p->events, DOWN | FAILED)) { continue; }
		touched |= BIT(i);
		err = radio_set_link_power(p->conn, next);
		if (err) { break; }
	}
	if (!err) { err = radio_set_scan_power(next); }
	if (!err) {
		atomic_set(&selected_dbm, next);
		indicator_feedback(1 + next / 4);
		return;
	}

	/* Keep both live links on the last confirmed level after a partial write. */
	for (unsigned i = 0; i < SIDES; ++i) {
		if ((touched & BIT(i)) && radio_set_link_power(peers[i].conn, prior)) {
			drop(&peers[i], err);
		}
	}
	atomic_set(&diag_error, err);
	indicator_feedback(0);
}
#endif

void asha_pair(void)
{
	atomic_set(&pairing, 1);
	indicator_set(LED_SEARCH);
	pair_until = k_uptime_get() + 60000;
	scan_after = 0;
}
#ifdef CONFIG_USB_ASHA_SONNET3
void asha_toggle_mics(void)
{
	struct bt_conn *connections[SIDES] = {0};
	for (unsigned i = 0; i < SIDES; ++i) {
		if (peers[i].ready) { connections[i] = peers[i].conn; }
	}
	sonnet_toggle(connections);
}
#endif

int asha_forget(void)
{
#ifdef CONFIG_USB_ASHA_SONNET3
	sonnet_cancel();
#endif
	stop_scan();
	atomic_clear(&pairing);
	asha_stop();
	for (unsigned i = 0; i < SIDES; ++i) {
		if (peers[i].conn) { drop(&peers[i], 0); }
	}
	return bt_unpair(BT_ID_DEFAULT, BT_ADDR_LE_ANY);
}
int asha_init(void)
{
	for (unsigned i = 0; i < SIDES; ++i) { k_event_init(&peers[i].events); }
	int err = bt_enable(NULL);
	return err ? err : settings_load();
}

static bool start(unsigned count)
{
	for (unsigned i = 0; i < SIDES; ++i) {
		struct peer *p = &peers[i];
		if (!p->ready) { continue; }
		int err = audio_reset(i) ? control(p, true, count == SIDES) : -ENOMEM;
		if (err) {
			drop(p, err);
			asha_stop();
			return false;
		}
		p->started = true;
	}
	stream++;
	sequence = 0;
	sent_first_frame = false;
	playing = true;
	atomic_set(&diag_stage, STREAMING);
	audio_flush();
	return true;
}

static void release_unsent(struct net_buf *buffers[SIDES])
{
	for (unsigned i = 0; i < SIDES; ++i) {
		if (buffers[i]) { net_buf_unref(buffers[i]); }
	}
}

void asha_audio(const struct audio_frame *frame)
{
	unsigned count = asha_ready();
	if (!count) { return; }
	if (!playing) {
		start(count);
		return; /* Consume a fresh frame after Start acknowledgements. */
	}
	struct net_buf *buffers[SIDES] = {0};
	for (unsigned i = 0; i < SIDES; ++i) {
		if (!peers[i].started) { continue; }
		buffers[i] = net_buf_alloc(&audio_buffers, K_NO_WAIT);
		if (!buffers[i]) {
			atomic_inc(&diag_tx_full);
			release_unsent(buffers);
			if (sent_first_frame) { sequence++; }
			return;
		}
	}

	int err = 0;
	unsigned slot;
	int8_t level = audio_volume();
	for (slot = 0; slot < SIDES; ++slot) {
		struct net_buf *buf = buffers[slot];
		if (!buf) { continue; }
		struct peer *p = &peers[slot];
		if (level != p->volume &&
		    !bt_gatt_write_without_response(p->conn, p->handle[VOLUME], &level, sizeof(level), false)) {
			p->volume = level;
		}
		net_buf_reserve(buf, BT_L2CAP_SDU_CHAN_SEND_RESERVE);
		net_buf_add_u8(buf, sequence);
		enum audio_route route = count == 1 ? ROUTE_MONO :
			(p->props[1] & 1) ? ROUTE_RIGHT : ROUTE_LEFT;
		if (!audio_encode(slot, route, frame, net_buf_add(buf, CODE_BYTES))) {
			err = -EIO;
			goto failed;
		}
	}

	/* On this single-core controller, the host TX worker can run after both
	 * nonblocking L2CAP queue operations. Radio interrupts can run throughout. */
	k_sched_lock();
	for (slot = 0; slot < SIDES; ++slot) {
		if (!buffers[slot]) { continue; }
		struct peer *p = &peers[slot];
		timing_submit(slot, p->props[1] & 1, stream, sequence, frame);
		err = bt_l2cap_chan_send(&p->channel.chan, buffers[slot]);
		if (err < 0) {
			timing_reject(slot);
			break;
		}
		buffers[slot] = NULL; /* The Bluetooth stack now owns this SDU. */
		atomic_inc(&diag_asdu);
	}
	k_sched_unlock();
	if (err < 0) { goto failed; }
	sent_first_frame = true;
	sequence++;
	return;

failed:
	release_unsent(buffers);
	drop(&peers[slot], err);
	asha_stop();
	tell_other(&peers[slot], 0);
}
```

## src/asha.h
```c
#pragma once
#include "audio.h"

int asha_init(void);
void asha_pair(void);
#ifdef CONFIG_USB_ASHA_POWER_BUTTON
int asha_power_dbm(void);
void asha_cycle_power(void);
#endif
int asha_forget(void);
#ifdef CONFIG_USB_ASHA_SONNET3
void asha_toggle_mics(void);
#endif
bool asha_pairing(void);
unsigned asha_ready(void);
bool asha_playing(void);
void asha_poll(void);
void asha_audio(const struct audio_frame *frame);
void asha_stop(void);
```

## src/audio.c
```c
#include "audio.h"
#include "dongle_controls.h"
#ifdef CONFIG_USB_ASHA_POWER_BUTTON
#include "asha.h"
#endif
#ifdef CONFIG_USB_ASHA_SONNET3
#include "sonnet_fir.h"
#include "sonnet_mix.h"
#endif
#include "asha.h"
#include "indicator.h"
#include "packet_timing.h"
#include <zephyr/fatal.h>
#include <zephyr/sys/reboot.h>
#include "g722_encoder.h"
#include <dsp/filtering_functions.h>
#include <zephyr/usb/usb_device.h>
#include <zephyr/usb/class/usb_audio.h>
#include <zephyr/sys/byteorder.h>
#include <string.h>

atomic_t diag_usb_packets, diag_frames, diag_asdu, diag_links, diag_stage, diag_error;
atomic_t diag_advertisements, diag_matches, diag_disconnects;
atomic_t diag_pcm_overruns, diag_pcm_stale, diag_tx_full, diag_encode_us, diag_encode_peak_us;
static __noinit struct { uint32_t magic, reason, pc, stage; } last_fault;
void k_sys_fatal_error_handler(unsigned int reason, const struct arch_esf *esf)
{
	last_fault.reason = reason;
	last_fault.pc = esf ? esf->basic.pc : 0;
	last_fault.stage = atomic_get(&diag_stage);
	last_fault.magic = 0x41534842;
	sys_reboot(SYS_REBOOT_WARM);
}
static const struct device *const hp = DEVICE_DT_GET_ONE(usb_audio_hp);
/* Producer, consumer and two queued frames each own a separate slab block. */
K_MEM_SLAB_DEFINE(frame_pool, sizeof(struct audio_frame), 4, 4);
K_MSGQ_DEFINE(frames, sizeof(struct audio_frame *), 2, sizeof(void *));
static struct audio_frame *assembling;
static unsigned filled;
static uint32_t previous_packet;
static atomic_t mute[3], db[3];

#ifdef CONFIG_USB_ASHA_SONNET3
/* 48 kHz to 16 kHz, 6.8 kHz passband and 7.75 kHz stopband, Q15. */
static const q15_t taps[] = {
	21, 39, 51, 47, 20, -12, -34, -26, 2, 33, 37, 11,
	-29, -48, -29, 19, 56, 50, -1, -57, -72, -26, 49, 91,
	59, -27, -101, -96, -7, 99, 131, 54, -79, -159, -111, 40,
	173, 172, 21, -165, -229, -102, 129, 274, 198, -60, -296, -303,
	-46, 283, 407, 190, -223, -497, -372, 101, 557, 592, 103, -567,
	-855, -425, 493, 1184, 957, -258, -1677, -2046, -454, 2951, 6861, 9461,
	9461, 6861, 2951, -454, -2046, -1677, -258, 957, 1184, 493, -425, -855,
	-567, 103, 592, 557, 101, -372, -497, -223, 190, 407, 283, -46,
	-303, -296, -60, 198, 274, 129, -102, -229, -165, 21, 172, 173,
	40, -111, -159, -79, 54, 131, 99, -7, -96, -101, -27, 59,
	91, 49, -26, -72, -57, -1, 50, 56, 19, -29, -48, -29,
	11, 37, 33, 2, -26, -34, -12, 20, 47, 51, 39, 21,
};
#else
/* 48 kHz, 7.2 kHz cutoff, 60-tap Kaiser window (beta 6), Q15. */
static const q15_t taps[] = {
	2,9,10,-3,-27,-36,-8,50,88,51,-63,-169,-147,39,267,318,66,-353,-582,-315,
	373,961,822,-219,-1535,-1937,-448,2892,6818,9461,9461,6818,2892,-448,-1937,-1535,
	-219,822,961,373,-315,-582,-353,66,318,267,39,-147,-169,-63,51,88,50,-8,-36,-27,-3,10,9,2
};
#endif
static struct {
	G722_ENC_CTX *encoder;
	arm_fir_decimate_instance_q15 fir;
	q15_t history[USB_SAMPLES + ARRAY_SIZE(taps) - 1];
} paths[SIDES];
#ifndef CONFIG_USB_ASHA_SONNET3
static int16_t mixed[USB_SAMPLES];
#endif
static int16_t filtered[PCM_SAMPLES];

/* Per-channel USB attenuation; the master level goes to the ASHA Volume characteristic. */
static const uint16_t gain_q15[] = {
	32768,29205,26029,23198,20675,18427,16423,14637,13045,11627,10362,9235,
	8231,7336,6538,5827,5193,4629,4125,3677,3277,2920,2603,2320,2068,1843,
	1642,1464,1305,1163,1036,924,823,734,654,583,519,463,413,368,328,292,
	260,232,207,184,164,146,130
};

void audio_release(struct audio_frame *frame)
{
	k_mem_slab_free(&frame_pool, frame);
}

static void publish_frame(uint32_t now)
{
	assembling->time_ms = now;
	assembling->usb_tick = k_cycle_get_32();
	assembling->number = (uint32_t)atomic_inc(&diag_frames) + 1;
	if (k_msgq_put(&frames, &assembling, K_NO_WAIT) != 0) {
		struct audio_frame *old;
		atomic_inc(&diag_pcm_overruns);
		if (!k_msgq_get(&frames, &old, K_NO_WAIT)) { audio_release(old); }
		if (k_msgq_put(&frames, &assembling, K_NO_WAIT) != 0) { audio_release(assembling); }
	}
	assembling = NULL;
	filled = 0;
}

static void receive(const struct device *dev, struct net_buf *buf, size_t bytes)
{
	uint32_t now = k_uptime_get_32();
	if (now - previous_packet > 8) {
		filled = 0;
	}
	previous_packet = now;
	if (bytes && bytes <= 192 && bytes % 4 == 0) {
		atomic_inc(&diag_usb_packets);
		for (size_t i = 0; i < bytes; i += 4) {
			if (!assembling && k_mem_slab_alloc(&frame_pool, (void **)&assembling, K_NO_WAIT)) {
				break;
			}
			assembling->samples[0][filled] = (int16_t)sys_get_le16(buf->data + i);
			assembling->samples[1][filled++] = (int16_t)sys_get_le16(buf->data + i + 2);
			if (filled == USB_SAMPLES) {
				publish_frame(now);
			}
		}
	}
	net_buf_unref(buf);
}

static void feature(const struct device *dev, const struct usb_audio_fu_evt *evt)
{
	if (evt->channel >= ARRAY_SIZE(db)) {
		return;
	}
	if (evt->cs == USB_AUDIO_FU_MUTE_CONTROL && evt->val_len == 1) {
		atomic_set(&mute[evt->channel], *(const uint8_t *)evt->val != 0);
	} else if (evt->cs == USB_AUDIO_FU_VOLUME_CONTROL && evt->val_len == 2) {
		int level = (int16_t)sys_get_le16(evt->val) / 256;
		atomic_set(&db[evt->channel], CLAMP(level, -48, 0));
	}
}

int8_t audio_volume(void)
{
	if (atomic_get(&mute[0])) { return -128; }
	int master = atomic_get(&db[0]);
	int steps = (master - 18) * 8 / 3;
#if defined(CONFIG_USB_ASHA_SONNET3) || defined(CONFIG_USB_ASHA_POWER_BUTTON)
	steps += stream_boost_steps(master, atomic_get(&db[1]), atomic_get(&db[2]));
#endif
	return MAX(-127, steps);
}

static int read_status(struct usb_setup_packet *req, int32_t *len, uint8_t **data)
{
	if (req->bRequest == 0x43 || req->bRequest == 0x44) { return timing_read(req, len, data); }
	if (req->bmRequestType != 0xc0 || req->wValue || req->wIndex) { return -ENOTSUP; }
#ifdef CONFIG_USB_ASHA_SONNET3
	if (req->bRequest == 0x45 && req->wLength == 4) {
		static uint32_t mix;
		mix = sys_cpu_to_le32(sonnet_status());
		*data = (uint8_t *)&mix;
		*len = sizeof(mix);
		return 0;
	}
#endif
#ifdef CONFIG_USB_ASHA_POWER_BUTTON
	if (req->bRequest == 0x46 && req->wLength == 1) {
		static uint8_t dbm;
		dbm = asha_power_dbm();
		*data = &dbm;
		*len = sizeof(dbm);
		return 0;
	}
#endif
	if (req->bRequest == 0x42 && req->wLength == 20) {
		static uint32_t timing[5];
		timing[0] = sys_cpu_to_le32(atomic_get(&diag_pcm_overruns));
		timing[1] = sys_cpu_to_le32(atomic_get(&diag_pcm_stale));
		timing[2] = sys_cpu_to_le32(atomic_get(&diag_tx_full));
		timing[3] = sys_cpu_to_le32(atomic_get(&diag_encode_us));
		timing[4] = sys_cpu_to_le32(atomic_get(&diag_encode_peak_us));
		*data = (uint8_t *)timing;
		*len = sizeof(timing);
		return 0;
	}
	if (req->bRequest != 0x41 || req->wLength != 64) {
		return -ENOTSUP;
	}
	static uint32_t report[16];
	report[0] = sys_cpu_to_le32(3);
	report[1] = sys_cpu_to_le32(atomic_get(&diag_usb_packets));
	report[2] = sys_cpu_to_le32(atomic_get(&diag_frames));
	report[3] = sys_cpu_to_le32(atomic_get(&diag_links));
	report[4] = sys_cpu_to_le32(atomic_get(&diag_asdu));
	report[5] = sys_cpu_to_le32(atomic_get(&diag_stage));
	report[6] = sys_cpu_to_le32(atomic_get(&diag_error));
	report[7] = sys_cpu_to_le32(atomic_get(&diag_advertisements));
	report[8] = sys_cpu_to_le32(atomic_get(&diag_matches));
	report[9] = sys_cpu_to_le32(asha_pairing());
	report[10] = sys_cpu_to_le32(indicator_on());
	report[11] = sys_cpu_to_le32(k_uptime_get_32());
	bool fault = last_fault.magic == 0x41534842;
	report[12] = sys_cpu_to_le32(fault ? last_fault.reason + 1 : 0);
	report[13] = sys_cpu_to_le32(fault ? last_fault.pc : 0);
	report[14] = sys_cpu_to_le32(fault ? last_fault.stage : 0);
	report[15] = sys_cpu_to_le32(atomic_get(&diag_disconnects));
	*data = (uint8_t *)report;
	*len = sizeof(report);
	return 0;
}

int audio_init(void)
{
	static const struct usb_audio_ops ops = {.data_received_cb = receive, .feature_update_cb = feature};
	if (!device_is_ready(hp)) {
		return -ENODEV;
	}
	/* Zephyr allocates the per-interface USB configuration in RAM. */
	struct usb_cfg_data *cfg = (struct usb_cfg_data *)hp->config;
	cfg->interface.vendor_handler = read_status;
	usb_audio_register(hp, &ops);
	return usb_enable(NULL);
}

struct audio_frame *audio_take(k_timeout_t timeout)
{
	struct audio_frame *frame;
	if (k_msgq_get(&frames, &frame, timeout) != 0) { return NULL; }
	if (k_uptime_get_32() - frame->time_ms < 45) { return frame; }
	atomic_inc(&diag_pcm_stale);
	audio_release(frame);
	return NULL;
}

void audio_flush(void)
{
	struct audio_frame *frame;
	while (!k_msgq_get(&frames, &frame, K_NO_WAIT)) { audio_release(frame); }
}

bool audio_reset(unsigned slot)
{
	if (paths[slot].encoder) {
		g722_encoder_destroy(paths[slot].encoder);
	}
	paths[slot].encoder = g722_encoder_new(64000, G722_DEFAULT);
	arm_status status = arm_fir_decimate_init_q15(&paths[slot].fir, ARRAY_SIZE(taps), 3,
						     taps, paths[slot].history, USB_SAMPLES);
	return status == ARM_MATH_SUCCESS && paths[slot].encoder;
}

bool audio_encode(unsigned slot, enum audio_route route, const struct audio_frame *frame,
		  uint8_t out[CODE_BYTES])
{
	int64_t began = k_uptime_ticks();
#ifdef CONFIG_USB_ASHA_SONNET3
	int16_t *mixed = paths[slot].history + ARRAY_SIZE(taps) - 1;
#endif
	int32_t left = atomic_get(&mute[1]) ? 0 : gain_q15[-atomic_get(&db[1])];
	int32_t right = atomic_get(&mute[2]) ? 0 : gain_q15[-atomic_get(&db[2])];
	for (unsigned i = 0; i < USB_SAMPLES; ++i) {
		int32_t l = (frame->samples[0][i] * left) >> 15;
		int32_t r = (frame->samples[1][i] * right) >> 15;
		mixed[i] = route == ROUTE_MONO ? (l + r) / 2 : route == ROUTE_LEFT ? l : r;
	}
#ifdef CONFIG_USB_ASHA_SONNET3
	BUILD_ASSERT(ARRAY_SIZE(taps) == 144 && PCM_SAMPLES % 4 == 0);
	sonnet_decimate(taps, paths[slot].history, filtered);
#else
	arm_fir_decimate_q15(&paths[slot].fir, mixed, filtered, USB_SAMPLES);
#endif
	int length = g722_encode(paths[slot].encoder, filtered, PCM_SAMPLES, out);
	uint32_t us = k_ticks_to_us_floor32(k_uptime_ticks() - began);
	atomic_set(&diag_encode_us, us);
	if (us > atomic_get(&diag_encode_peak_us)) { atomic_set(&diag_encode_peak_us, us); }
	return length == CODE_BYTES;
}
```

## src/audio.h
```c
#pragma once

#include <zephyr/kernel.h>
#include <stdint.h>

enum { SIDES = 2, USB_SAMPLES = 960, PCM_SAMPLES = 320, CODE_BYTES = 160 };
struct audio_frame {
	uint32_t time_ms, number, usb_tick;
	int16_t samples[SIDES][USB_SAMPLES];
};

enum audio_route { ROUTE_LEFT, ROUTE_RIGHT, ROUTE_MONO };
int audio_init(void);
struct audio_frame *audio_take(k_timeout_t timeout);
void audio_release(struct audio_frame *frame);
void audio_flush(void);
int8_t audio_volume(void);
bool audio_reset(unsigned slot);
bool audio_encode(unsigned slot, enum audio_route route, const struct audio_frame *frame,
		  uint8_t out[CODE_BYTES]);

/* Small read-only status snapshot for the USB host. */
extern atomic_t diag_usb_packets, diag_frames, diag_asdu, diag_links, diag_stage, diag_error;
extern atomic_t diag_advertisements, diag_matches, diag_disconnects;
extern atomic_t diag_pcm_overruns, diag_pcm_stale, diag_tx_full, diag_encode_us, diag_encode_peak_us;
```

## src/dongle_controls.h
```c
#pragma once
#include <stdbool.h>
#include <stdint.h>

static inline int stream_boost_steps(int master_db, int left_db, int right_db)
{
	/* 0.375 dB per ASHA step. Add nothing through -24 dB USB. */
	int level = master_db + (left_db < right_db ? left_db : right_db);
	return level > -24 ? (level + 24) * 16 / 24 : 0;
}

enum button_action { BUTTON_NONE, BUTTON_TAP, BUTTON_RESET, BUTTON_POWER };
struct button_state { int64_t since; bool down, handled; };
static inline enum button_action button_update(struct button_state *b, bool down, int64_t now)
{
	if (!b->down && down) {
		b->since = now;
		b->handled = false;
	}
	int64_t held = now - b->since;
	bool was_down = b->down;
	b->down = down;
	if (was_down && !b->handled && held >= 5000) {
		b->handled = true;
		return BUTTON_RESET;
	}
#ifdef CONFIG_USB_ASHA_POWER_BUTTON
	if (was_down && !down && !b->handled && held >= 2000) { return BUTTON_POWER; }
#endif
	return was_down && !down && !b->handled && held >= 30 && held < 750 ? BUTTON_TAP : BUTTON_NONE;
}

static inline int next_radio_dbm(int current)
{
	return current == 8 ? 0 : current + 4;
}
```

## src/indicator.c
```c
#include "indicator.h"
#include <zephyr/kernel.h>
#include <zephyr/drivers/gpio.h>

/* Standard CX-40 assemblies populate D1 (active-low P0.06). */
static const struct gpio_dt_spec led = GPIO_DT_SPEC_GET(DT_NODELABEL(led0_d1), gpios);
static atomic_t mode, confirmed, confirm_time, lit;

#if defined(CONFIG_USB_ASHA_SONNET3) || defined(CONFIG_USB_ASHA_POWER_BUTTON)
static atomic_t feedback_signal, feedback_time;
void indicator_feedback(unsigned flashes)
{
	atomic_set(&feedback_time, (atomic_val_t)k_uptime_get_32());
	atomic_set(&feedback_signal, flashes + 1);
}
#endif

static bool pattern(uint32_t now)
{
	if (now < 900) { return true; }
#if defined(CONFIG_USB_ASHA_SONNET3) || defined(CONFIG_USB_ASHA_POWER_BUTTON)
	int signal = atomic_get(&feedback_signal);
	uint32_t age = now - (uint32_t)atomic_get(&feedback_time);
	uint32_t duration = IS_ENABLED(CONFIG_USB_ASHA_POWER_BUTTON) && signal == 4 ? 1800U : 1350U;
	if (signal > 0 && age < duration) {
		if (signal == 1) { return age % 180 >= 90; }
		return age >= 160 && age < 160 + (signal - 1U) * 480 && (age - 160) % 480 < 320;
	}
#endif
	if (atomic_get(&confirmed)) {
		uint32_t elapsed = now - (uint32_t)atomic_get(&confirm_time);
		if (elapsed < 2400) { return elapsed % 800 < 500; }
	}
	switch (atomic_get(&mode)) {
	case LED_SEARCH:    return now % 400 < 200;
	case LED_CONNECT:   return now % 800 < 100 || (now % 800 >= 200 && now % 800 < 300);
	case LED_CONNECTED: return true;
	case LED_AUDIO:     return now % 2000 >= 100;
	case LED_ERROR:     return now % 160 < 80;
	default:            return now % 2000 < 75;
	}
}

static void tick(struct k_timer *timer)
{
	bool next = pattern(k_uptime_get_32());
	gpio_pin_set_dt(&led, next);
	atomic_set(&lit, next);
}
K_TIMER_DEFINE(indicator_timer, tick, NULL);

void indicator_init(void)
{
	gpio_pin_configure_dt(&led, GPIO_OUTPUT_INACTIVE);
	k_timer_start(&indicator_timer, K_NO_WAIT, K_MSEC(25));
}
void indicator_set(enum led_state state) { atomic_set(&mode, state); }
void indicator_confirm(void)
{
	atomic_set(&confirm_time, k_uptime_get_32());
	atomic_set(&confirmed, 1);
}
bool indicator_on(void) { return atomic_get(&lit); }
```

## src/indicator.h
```c
#pragma once
#include <stdbool.h>

enum led_state { LED_IDLE, LED_SEARCH, LED_CONNECT, LED_CONNECTED, LED_AUDIO, LED_ERROR };
void indicator_init(void);
void indicator_set(enum led_state state);
void indicator_confirm(void);
bool indicator_on(void);
#if defined(CONFIG_USB_ASHA_SONNET3) || defined(CONFIG_USB_ASHA_POWER_BUTTON)
void indicator_feedback(unsigned flashes);
#endif
```

## src/packet_timing.c
```c
#include "packet_timing.h"
#include <string.h>

/* The wire format follows the little-endian nRF52840. Times are RTC ticks. */
struct packet {
	uint32_t frame, usb_tick, submit_tick, complete_tick;
	uint16_t stream;
	uint8_t sequence, ear;
};
BUILD_ASSERT(sizeof(struct packet) == 20);

enum { PENDING = 64, HISTORY = 1024, PAGE = 32 };
static struct {
	struct { uint32_t ticket; struct packet packet; } entries[PENDING];
	uint32_t in, out;
} pending[SIDES];
static struct packet history[HISTORY];
static uint32_t next_record, retained, unmatched;
static struct k_spinlock lock;

void timing_channel_open(unsigned slot)
{
	k_spinlock_key_t key = k_spin_lock(&lock);
	/* A closed channel can discard SDUs without successful sent callbacks. */
	unmatched += pending[slot].in - pending[slot].out;
	pending[slot].in = pending[slot].out = 0;
	k_spin_unlock(&lock, key);
}

void timing_submit(unsigned slot, unsigned ear, uint16_t stream, uint8_t sequence,
		   const struct audio_frame *frame)
{
	k_spinlock_key_t key = k_spin_lock(&lock);
	uint32_t ticket = pending[slot].in++;
	pending[slot].entries[ticket % PENDING].ticket = ticket;
	pending[slot].entries[ticket % PENDING].packet = (struct packet){
		.frame = frame->number, .usb_tick = frame->usb_tick,
		.submit_tick = k_cycle_get_32(), .stream = stream, .sequence = sequence, .ear = ear
	};
	k_spin_unlock(&lock, key);
}

void timing_reject(unsigned slot)
{
	/* Only the audio thread submits. A rejected send never gets a callback. */
	k_spinlock_key_t key = k_spin_lock(&lock);
	pending[slot].in--;
	k_spin_unlock(&lock, key);
}

void timing_complete(unsigned slot)
{
	uint32_t now = k_cycle_get_32();
	k_spinlock_key_t key = k_spin_lock(&lock);
	uint32_t outstanding = pending[slot].in - pending[slot].out;
	if (outstanding) {
		uint32_t ticket = pending[slot].out++;
		if (pending[slot].entries[ticket % PENDING].ticket == ticket) {
			struct packet *record = &history[next_record++ % HISTORY];
			*record = pending[slot].entries[ticket % PENDING].packet;
			record->complete_tick = now;
			retained = MIN(retained + 1U, HISTORY);
		} else {
			/* Its tag was overwritten. Never attribute it to a newer frame. */
			unmatched++;
		}
	} else {
		unmatched++;
	}
	k_spin_unlock(&lock, key);
}

int timing_read(const struct usb_setup_packet *req, int32_t *len, uint8_t **data)
{
	static uint32_t info[5];
	static struct timing_page {
		uint32_t first, end, unmatched;
		struct packet entries[PAGE];
	} page;
	if (req->bmRequestType != 0xc0) { return -ENOTSUP; }
	if (req->bRequest == 0x43 && !req->wIndex && !req->wValue && req->wLength == sizeof(info)) {
		k_spinlock_key_t key = k_spin_lock(&lock);
		info[0] = CONFIG_USB_ASHA_BUILD_NUMBER;
		info[1] = sys_clock_hw_cycles_per_sec();
		info[2] = next_record;
		info[3] = unmatched;
		info[4] = k_cycle_get_32();
		k_spin_unlock(&lock, key);
		*data = (uint8_t *)info;
		*len = sizeof(info);
		return 0;
	}
	if (req->bRequest != 0x44 || req->wLength != sizeof(page)) { return -ENOTSUP; }

	/* An addressed read can be safely retried after a USB error. */
	uint32_t cursor = ((uint32_t)req->wIndex << 16) | req->wValue;
	k_spinlock_key_t key = k_spin_lock(&lock);
	uint32_t available = MIN(next_record - cursor, retained);
	page.first = next_record - available;
	page.end = next_record;
	page.unmatched = unmatched;
	unsigned count = MIN(available, PAGE);
	unsigned pos = page.first % HISTORY;
	unsigned chunk = MIN(count, HISTORY - pos);
	memcpy(page.entries, &history[pos], chunk * sizeof(struct packet));
	memcpy(page.entries + chunk, history, (count - chunk) * sizeof(struct packet));
	k_spin_unlock(&lock, key);
	*data = (uint8_t *)&page;
	*len = offsetof(struct timing_page, entries) + count * sizeof(struct packet);
	return 0;
}
```

## src/packet_timing.h
```c
#pragma once

#include "audio.h"
#include <zephyr/usb/usb_device.h>

void timing_channel_open(unsigned slot);
void timing_submit(unsigned slot, unsigned ear, uint16_t stream, uint8_t sequence,
		   const struct audio_frame *frame);
void timing_reject(unsigned slot);
void timing_complete(unsigned slot);
int timing_read(const struct usb_setup_packet *req, int32_t *len, uint8_t **data);
```

## src/radio_power.c
```c
#include "radio_power.h"
#include <zephyr/bluetooth/hci.h>
#include <zephyr/bluetooth/hci_vs.h>
#include <zephyr/sys/byteorder.h>
#include <errno.h>

static int set_power(uint8_t type, uint16_t handle, int8_t dbm)
{
	struct net_buf *buf = bt_hci_cmd_alloc(K_NO_WAIT);
	if (!buf) { return -ENOBUFS; }
	struct bt_hci_cp_vs_write_tx_power_level *cmd = net_buf_add(buf, sizeof(*cmd));
	cmd->handle_type = type;
	cmd->handle = sys_cpu_to_le16(handle);
	cmd->tx_power_level = dbm;

	struct net_buf *rsp = NULL;
	int err = bt_hci_cmd_send_sync(BT_HCI_OP_VS_WRITE_TX_POWER_LEVEL, buf, &rsp);
	if (err) { return err; }
	const struct bt_hci_rp_vs_write_tx_power_level *result = (const void *)rsp->data;
	if (rsp->len != sizeof(*result) || result->status || result->handle_type != type ||
	    sys_le16_to_cpu(result->handle) != handle || result->selected_tx_power != dbm) {
		err = -EIO;
	}
	net_buf_unref(rsp);
	return err;
}

int radio_set_scan_power(int8_t dbm)
{
	return set_power(BT_HCI_VS_LL_HANDLE_TYPE_SCAN, 0, dbm);
}

int radio_set_link_power(struct bt_conn *conn, int8_t dbm)
{
	uint16_t handle;
	int err = bt_hci_get_conn_handle(conn, &handle);
	return err ? err : set_power(BT_HCI_VS_LL_HANDLE_TYPE_CONN, handle, dbm);
}
```

## src/radio_power.h
```c
#pragma once
#include <zephyr/bluetooth/conn.h>

int radio_set_scan_power(int8_t dbm);
int radio_set_link_power(struct bt_conn *conn, int8_t dbm);
```

## src/sonnet_controls.h
```c
#pragma once
#include <stdbool.h>
#include <stdint.h>

/* The processor stores one streaming source mask per listening program. */
enum sonnet_mode { MIC_UNKNOWN, MIC_MIXED, MIC_STREAM_ONLY };
static inline enum sonnet_mode sonnet_current(const uint8_t flags[5], uint8_t source, uint8_t program)
{
	if (source >= 8 || program >= 5) { return MIC_UNKNOWN; }
	uint8_t mask = flags[program];
	if (!mask) { return MIC_MIXED; }
	if ((mask & 0xfe) == 0xfe) { return MIC_STREAM_ONLY; }
	if (!source) { return MIC_UNKNOWN; }
	return (mask & (1U << source)) ? MIC_STREAM_ONLY : MIC_MIXED;
}
```
